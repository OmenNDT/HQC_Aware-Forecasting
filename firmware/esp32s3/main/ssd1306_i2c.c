/* ssd1306_i2c.c — driver tối thiểu SSD1306 128×64 qua I2C (driver i2c_master của ESP-IDF 5.x).
 * Framebuffer 8 trang × 128 cột, mỗi byte = 8 pixel dọc. Font 5×7 cho ký tự 32..95 (in hoa, số, dấu). */
#include "ssd1306_i2c.h"
#include "bench_pins.h"
#include <string.h>
#include "driver/i2c_master.h"
#include "esp_log.h"

static const char *TAG = "oled";
static i2c_master_bus_handle_t s_bus; static i2c_master_dev_handle_t s_dev;
static uint8_t s_fb[8][128]; static char s_found[64] = "";
const char *oled_i2c_found(void) { return s_found; }

static const uint8_t FONT[64][5] = {
    {0x00,0x00,0x00,0x00,0x00},{0x00,0x00,0x5F,0x00,0x00},{0x00,0x07,0x00,0x07,0x00},{0x14,0x7F,0x14,0x7F,0x14},
    {0x24,0x2A,0x7F,0x2A,0x12},{0x23,0x13,0x08,0x64,0x62},{0x36,0x49,0x55,0x22,0x50},{0x00,0x05,0x03,0x00,0x00},
    {0x00,0x1C,0x22,0x41,0x00},{0x00,0x41,0x22,0x1C,0x00},{0x14,0x08,0x3E,0x08,0x14},{0x08,0x08,0x3E,0x08,0x08},
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    {0x02,0x04,0x08,0x10,0x20},{0x00,0x41,0x41,0x7F,0x00},{0x04,0x02,0x01,0x02,0x04},{0x40,0x40,0x40,0x40,0x40},
};

static int cmd(const uint8_t *c, int n) { uint8_t buf[16] = { 0x00 }; memcpy(buf + 1, c, n); return i2c_master_transmit(s_dev, buf, n + 1, 100) == ESP_OK ? 0 : -1; }

int oled_init(void) {
    i2c_master_bus_config_t bus = { .i2c_port = I2C_NUM_0, .sda_io_num = PIN_I2C_SDA, .scl_io_num = PIN_I2C_SCL,
                                    .clk_source = I2C_CLK_SRC_DEFAULT, .glitch_ignore_cnt = 7, .flags.enable_internal_pullup = true };
    if (!s_bus) { if (i2c_new_master_bus(&bus, &s_bus) != ESP_OK) return -1; esp_log_level_set("i2c.master", ESP_LOG_NONE); }   /* gọi lại được nhiều lần; tắt log driver để không lẫn vào luồng JSON */
    /* quét bus để chẩn đoán dây: liệt kê địa chỉ có ACK */
    { int n = 0; s_found[0] = 0; for (int a = 0x08; a < 0x78 && n < 56; a++) if (i2c_master_probe(s_bus, a, 20) == ESP_OK) n += snprintf(s_found + n, sizeof s_found - n, "%s0x%02X", n ? "," : "", a); }
    i2c_device_config_t dev = { .dev_addr_length = I2C_ADDR_BIT_LEN_7, .device_address = 0x3C, .scl_speed_hz = 400000 };
    if (!strstr(s_found, "0x3C")) return -1;   /* chưa thấy OLED trên bus thì không gửi chuỗi khởi tạo */
    if (!s_dev && i2c_master_bus_add_device(s_bus, &dev, &s_dev) != ESP_OK) return -1;
    static const uint8_t init_seq[] = { 0xAE, 0xD5, 0x80, 0xA8, 0x3F, 0xD3, 0x00, 0x40, 0x8D, 0x14, 0x20, 0x00, 0xA1, 0xC8,
                                        0xDA, 0x12, 0x81, 0x7F, 0xD9, 0xF1, 0xDB, 0x40, 0xA4, 0xA6, 0xAF };
    for (unsigned i = 0; i < sizeof init_seq; i++) if (cmd(&init_seq[i], 1)) { ESP_LOGW(TAG, "không thấy OLED 0x3C: kiểm tra SDA/SCL/VCC"); return -1; }
    oled_clear(); oled_flush();
    ESP_LOGI(TAG, "OLED ok");
    return 0;
}

void oled_clear(void) { memset(s_fb, 0, sizeof s_fb); }

static void px(int x, int y) { if (x < 0 || x >= 128 || y < 0 || y >= 64) return; s_fb[y >> 3][x] |= (uint8_t)(1 << (y & 7)); }

void oled_text(int x, int y, const char *s, int scale) {
    if (scale < 1) scale = 1;
    for (; *s; s++, x += 6 * scale) {
        int c = (unsigned char)*s; if (c >= 'a' && c <= 'z') c -= 32; if (c < 32 || c > 95) c = '?';
        const uint8_t *g = FONT[c - 32];
        for (int col = 0; col < 5; col++) for (int row = 0; row < 7; row++) if (g[col] & (1 << row))
            for (int dx = 0; dx < scale; dx++) for (int dy = 0; dy < scale; dy++) px(x + col * scale + dx, y + row * scale + dy);
    }
}

void oled_hline(int x0, int x1, int y) { for (int x = x0; x <= x1; x++) px(x, y); }

void oled_bar(int x, int y, int w, int h, int fill_w) {
    oled_hline(x, x + w - 1, y); oled_hline(x, x + w - 1, y + h - 1);
    for (int yy = y; yy < y + h; yy++) { px(x, yy); px(x + w - 1, yy); }
    if (fill_w > w) fill_w = w;
    for (int xx = x; xx < x + fill_w; xx++) for (int yy = y + 1; yy < y + h - 1; yy++) px(xx, yy);
}

void oled_flush(void) {
    for (int page = 0; page < 8; page++) {
        uint8_t c[3] = { (uint8_t)(0xB0 | page), 0x00, 0x10 }; cmd(c, 3);
        uint8_t buf[129] = { 0x40 }; memcpy(buf + 1, s_fb[page], 128);
        i2c_master_transmit(s_dev, buf, 129, 100);
    }
}
